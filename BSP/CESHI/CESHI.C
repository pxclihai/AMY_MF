#include "config.h"

#if		CONF_CESHI_EN	
/*******************************************************************************
* 函 数 名         : USART3_sendchar(u8 ch)
* 函数功能		   : 串口3发送数据位
* 输    入         : 无
* 输    出         : 无
*******************************************************************************/
//u8 NO[16]={0x30,0x31,0x32,0x33,0x34,0x35,0x36,0x37,0x38,0x39,0x41,0x42,0x43,0x44,0x45,0x46};
void USART5_sendchar(u8 ch)
{
			USART_SendData(UART5,ch);//通过外设USARTx发送单个数据
		
		while(USART_GetFlagStatus(UART5,USART_FLAG_TXE)==RESET);

}

/*******************************************************************************
* 函 数 名         : sendchar()
* 函数功能		   : 串口1发送数据位
* 输    入         : 无
* 输    出         : 无
*******************************************************************************/

void qwl_sendchar(u8 ch)
{
   	
	USART5_sendchar(ch);
}

/*******************************************************************************
* 函 数 名         : send字符串()
* 函数功能		   : 串口1发送数据位
* 输    入         : 无
* 输    出         : 无
*******************************************************************************/
void qwl_sendstring(u8 *p)
{
  	while(*p)
  	{
  		qwl_sendchar(*p);
  		p++;
	}
	qwl_sendchar(0x0d);
	qwl_sendchar(0x0a);
}
/*******************************************************************************
* 函 数 名         : send字符串()
* 函数功能		   : 串口1发送数据位
* 输    入         : 无
* 输    出         : 无
*******************************************************************************/
void qwl_sendstring1(u8 *p)
{
  	while(*p)
  	{
  		qwl_sendchar(*p);
  		p++;
	}
}
#include <stdio.h>
int fputc(int ch, FILE *f)
{
  USART_SendData(UART5, (uint8_t) ch);
  /* Loop until the end of transmission */
  while (USART_GetFlagStatus(UART5, USART_FLAG_TC) == RESET)
  {}
  return ch;
}
#endif
/******************************************************************************/

